#include <Adafruit_SSD1306.h>
#include <PS2X_lib.h>
#include <AFMotor.h>
 AF_DCMotor frente_esquerda(4); 
  AF_DCMotor frente_direita(1);
  AF_DCMotor tras_direita(2); 
  AF_DCMotor tras_esquerda(3); 
PS2X ps2x;
  int max_speed = 255 ; 
  int tolerancia = 30;  
  int motor_y ; 
  int motor_x ;

   int raio_olho = 7 ; 
  int olho_y ;
  int olho_x ; 

  int error = 0;
  byte type = 0;
  byte vibrate = 0;
Adafruit_SSD1306 display(128,64,&Wire, -1);
const unsigned char DinossauroBebadoLogo [] PROGMEM = {
  0xf0, 0xff, 0xff, 0xff, 0xff, 0xff, 0xff, 0xff, 0xff, 0xff, 0xff, 0xff, 0xfe, 0x80, 0x07, 0xff, 
  0xff, 0xff, 0xff, 0xff, 0xff, 0xff, 0xff, 0xff, 0xff, 0xfe, 0x80, 0x00, 0x7f, 0xff, 0xff, 0xfe, 
  0x00, 0x3f, 0xff, 0xff, 0xff, 0xff, 0xfe, 0x80, 0x00, 0x0f, 0xff, 0xff, 0xe0, 0x00, 0x03, 0xff, 
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  0xff, 0xf8, 0x00, 0xff, 0xff, 0xff, 0xff, 0xff, 0xff, 0xff, 0xff, 0xff, 0xff, 0xff, 0xff, 0xfe
};
void setup(){
display.begin(SSD1306_SWITCHCAPVCC, 0x3C);
display.clearDisplay();
logo();
display.invertDisplay(0);
delay(1000);
display.clearDisplay();
texto("Rangi","por :",1000);
texto("Dinossauro","Bebado",1000);

frente_esquerda.setSpeed(max_speed); 
  frente_direita.setSpeed(max_speed); 
  tras_esquerda.setSpeed(max_speed); 
  tras_direita.setSpeed(max_speed); 
  //error = ps2x.config_gamepad(13,9,10,2, false, false);  
  //Testa por erros na conexão ps2<--> Adaptador
        if(error == 0){
         Serial.println("Found Controller, configured successful");
         texto("Controle","Achado",500);
       }
        
        else if(error == 1){
         Serial.println("No controller found, check wiring, see readme.txt to enable debug.");
         texto("Conecte","Controle",500);
        }
        else if(error == 2){
         Serial.println("Controller found but not accepting commands. see readme.txt to enable debug.");
         texto("Controle","Bugado",500);
        }
        else if(error == 3){
         Serial.println("Controller refusing to enter Pressures mode, may not support it. ");
        }
        type = ps2x.readType(); 
        
         switch(type) {
             case 0:
              Serial.println("Unknown Controller type");
              texto("Controle","Desconhecido",500);
             break;
             case 1:
              Serial.println("DualShock Controller Found");
              texto("Dualshock","Conectado",500);
             break;
             case 2:
              Serial.println("GuitarHero Controller Found");
              texto("Erro","01",500);
              break;
     }

}

void loop() {}

void texto(const char* palavra_cima, const char* palavra_baixo, int tempo){
   display.clearDisplay();
   display.setTextColor(WHITE);
   display.setTextSize(2);
   display.setCursor(0,0);
   display.println(palavra_cima);
   display.println(palavra_baixo);
   display.display();
   delay(tempo);
   display.clearDisplay();
 }
 void logo(){
   display.drawBitmap(10, 0,  DinossauroBebadoLogo, 103, 64, WHITE);
   display.fillRect(0, 0, 10, 64, WHITE);
   display.fillRect(113, 0, 20, 64, WHITE);
   display.invertDisplay(1);
   display.display();
   delay(5000);}

void direita(){
  frente_esquerda.run(FORWARD); ; 
  frente_direita.run(BACKWARD);
  tras_direita.run(BACKWARD); 
  tras_esquerda.run(FORWARD); 
  display.fillCircle(0, display.height()/2, raio_olho, WHITE);
  display.display();
}
void esquerda(){
  frente_esquerda.run(BACKWARD);
  frente_direita.run(FORWARD);
  tras_direita.run(FORWARD); 
  tras_esquerda.run(BACKWARD); 
 display.fillCircle(128, display.height()/2, raio_olho, WHITE);
  display.display();
}
void tras(){
  frente_esquerda.run(BACKWARD); 
  frente_direita.run(BACKWARD);
  tras_direita.run(BACKWARD); 
  tras_esquerda.run(BACKWARD); 
  
  }
void frente(){
    frente_esquerda.run(FORWARD); 
    frente_direita.run(FORWARD);
    tras_direita.run(FORWARD); 
    tras_esquerda.run(FORWARD); 
  
}


void texto_central(const char* palavra_cima, const char* palavra_baixo, int tempo){
   display.clearDisplay();
   display.setTextColor(WHITE);
   display.setTextSize(2);
   display.setCursor(display.width()/2,display.height()/2);
   display.println(palavra_cima);
   display.println(palavra_baixo);        
   display.display();
   delay(tempo);
   display.clearDisplay();
 } 

 void olho(int X,int Y){
      // coloca o circulo no espaço recebendo as cordenadas 
      display.clearDisplay();
      display.fillCircle(X, Y, raio_olho, WHITE);
      display.display();
      Serial.print(Y); 
      Serial.print(":");
      Serial.println(X);  
      display.clearDisplay();
  }

void emocao(char expressao,int olho_x,int olho_y,int tamanho ){
   //função que cria as emoções recebe o caracter que vai ser usado e a posição no espaço alem do tamanho 
   Serial.println(expressao);
   display.clearDisplay();
   display.setTextColor(WHITE);
   display.setTextSize(tamanho);
   display.setCursor(olho_x,olho_y);
   display.println(expressao);
   display.display();
   delay(200);
   display.clearDisplay();
   }
